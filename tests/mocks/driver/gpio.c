/*!
 *******************************************************************************
 * @file gpio.c
 *
 * @brief 
 *
 * @author Raúl Gotor (raulgotor@gmail.com)
 * @date 17.02.22
 *
 * @par
 * COPYRIGHT NOTICE: (c) 2022 Raúl Gotor
 * All rights reserved.
 *******************************************************************************
 */

/*
 *******************************************************************************
 * #include Statements                                                         *
 *******************************************************************************
 */

#include "driver/gpio.h"
#include "gpio_types.h"
#include "sdkconfig.h"
#include "gpio_spy.h"
/*
 *******************************************************************************
 * Private Macros                                                              *
 *******************************************************************************
 */

/*
 *******************************************************************************
 * Data types                                                                  *
 *******************************************************************************
 */

/*
 *******************************************************************************
 * Constants                                                                   *
 *******************************************************************************
 */

/*
 *******************************************************************************
 * Private Function Prototypes                                                 *
 *******************************************************************************
 */

/*
 *******************************************************************************
 * Public Data Declarations                                                    *
 *******************************************************************************
 */

/*
 *******************************************************************************
 * Static Data Declarations                                                    *
 *******************************************************************************
 */

static uint32_t m_pin_levels[GPIO_NUM_MAX];

static bool m_is_spy_initialized = false;

/*
 *******************************************************************************
 * Public Function Bodies                                                      *
 *******************************************************************************
 */

esp_err_t gpio_set_level(gpio_num_t gpio_num, uint32_t level)
{
        m_pin_levels[gpio_num] = level;

        return ESP_OK;
}

esp_err_t gpio_config(const gpio_config_t *pGPIOConfig)
{
        return ESP_OK;
}

esp_err_t gpio_spy_get_pin_level(gpio_num_t gpio_num, uint32_t *level)
{

        esp_err_t result = ESP_OK;

        if (NULL == level) {
                result = ESP_ERR_INVALID_ARG;
        } else if (!m_is_spy_initialized) {
                result = ESP_FAIL;
        }

        *level = m_pin_levels[gpio_num];

        return result;

}

void gpio_spy_init(void)
{
        size_t i = 0;

        for (i = 0; GPIO_NUM_MAX > i; ++i) {
                m_pin_levels[i] = 0;
        }

        m_is_spy_initialized = true;
}

void gpio_spy_deinit(void) {
        // NOP
}
/*
 *******************************************************************************
 * Private Function Bodies                                                     *
 *******************************************************************************
 */

/*
 *******************************************************************************
 * Interrupt Service Routines / Tasks / Thread Main Functions                  *
 *******************************************************************************
 */
